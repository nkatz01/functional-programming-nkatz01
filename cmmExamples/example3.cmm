n = 8
k = 1
f = 1
while (k <= n) {
    f = f * k 
    print k,f 
    k = k + 1
}