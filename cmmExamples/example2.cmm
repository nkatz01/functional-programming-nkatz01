val = 1

while (val < 100) {
    print val
    val = 2 * val 
}