n = 10
a = 0
b = 1
while (n > 0) {
    c = a + b 
    a = b 
    b = c 
    n = n - 1 
    print a
}