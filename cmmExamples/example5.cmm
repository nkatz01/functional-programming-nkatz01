n = 500
low = 0
high = n + 1
while (high - low >= 2) {
	mid = (low + high) / 2
   	if (mid * mid <= n) 
   		low = mid 
   	else 
   		high = mid
	print low, high
}
print low